## firmware/boards/m3/bsp_p4_m3/Kconfig
```kconfig
menu "Pajoniiir JC-ESP32P4-M3 BSP"

config BSP_M3_HS_CONTROLLER
    bool "Experimental: controller on USB3 HS, storage on USB2 FS"
    default n
    help
        Opt-in USB role swap for controllers whose MIDI interface requires
        High Speed, including the captured S2 MK3. This is not the accepted
        FLX4 production topology. Descriptor-validated UAC2 is experimental;
        qualify controller audio, FS storage throughput and recovery separately.

config BSP_PCM5102A_MAIN_OUT
    bool "Enable PCM5102A main I2S output"
    default y
    help
        Enable the I2S TX channel for the external PCM5102A MAIN OUT DAC.

config BSP_ES8311_MONITOR
    bool "Enable ES8311 onboard monitor codec"
    default n
    help
        Bring up the ES8311 codec on I2S unit 0 for the onboard monitor
        speaker/headphones path.

endmenu
```

## firmware/p4-core/components/controller_usb_host/Kconfig
```kconfig
menu "Controller USB diagnostics"
config CONTROLLER_USB_HS_AUDIO_DIAGNOSTIC
    bool "Diagnostic: defer HS audio until validated boot; quarantine after panic"
    default n
    depends on ESP_COREDUMP_ENABLE_TO_FLASH
    help
        Bench-only HS audio investigation. MIDI initializes normally; HS audio
        waits at least ten seconds and for OTA validation. After a panic, HS
        audio remains disabled for that boot so Wi-Fi can expose the crash dump.
        Does not bypass startup health or change the FS/FLX4 audio path.
        Runtime memory snapshots omit largest-block walks on all builds,
        independently of this option; free and low-water counters remain.
        Installs USB interrupts on core 1. With bus trace enabled, kind 3
        records suspect HS OUT start indices after channel activation;
        intr is raw HFNUM and event is the descriptor start index.
endmenu
```

## firmware/p4-core/components/usb_host_manager/Kconfig
```kconfig
menu "USB host diagnostics"
    config USB_HOST_DIAGNOSTIC_BUS_TRACE
        bool "Diagnostic: capture bounded USB bus fault history"
        depends on IDF_TARGET_ESP32P4
        default n
        help
            Record the last eight port transitions/channel errors per root
            in RAM, without logging or changing USB recovery. Read through
            /api/usb-bus-trace. Bench diagnosis only; disabled in production.
    config USB_HOST_DIAGNOSTIC_HS_ONLY
        bool "Diagnostic: install only the HS USB host"
        depends on IDF_TARGET_ESP32P4
        default n
        help
            Isolate HS controller enumeration/transfer faults from the second
            FS host. Storage on the FS root is unavailable. Bench diagnosis
            only; never use this configuration for a product release.
endmenu
```

## firmware/p4-core/components/wifi_link/Kconfig
```kconfig
menu "Pajoniiir Wi-Fi diagnostics"
config WIFI_LINK_DIAGNOSTIC_LOW_TX_POWER
    bool "Limit SoftAP TX power to 2 dBm for S2 coexistence comparison"
    depends on PAJONIIIR_BOARD_M3 && CONTROLLER_USB_HS_AUDIO_DIAGNOSTIC
    default n
    help
        Bench-only comparison. After AP_START, set and read back an 8-quarter-dBm
        maximum. The earliest startup transmissions are not covered. Normal
        builds retain the C6 default. Does not change SDIO or USB timing.
endmenu
```
